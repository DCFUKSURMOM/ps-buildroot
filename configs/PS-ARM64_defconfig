## configs/PS-ARM64_defconfig
```kconfig
BR2_aarch64=y
BR2_TOOLCHAIN_EXTERNAL=y
BR2_TOOLCHAIN_EXTERNAL_BOOTLIN=y
BR2_TOOLCHAIN_EXTERNAL_BOOTLIN_AARCH64_GLIBC_STABLE=y
BR2_INIT_NONE=y
BR2_ROOTFS_MERGED_USR=y
BR2_ROOTFS_MERGED_BIN=y
# BR2_TARGET_ENABLE_ROOT_LOGIN is not set
BR2_SYSTEM_BIN_SH_NONE=y
# BR2_TARGET_GENERIC_GETTY is not set
# BR2_TARGET_GENERIC_REMOUNT_ROOTFS_RW is not set
BR2_PACKAGE_BUSYBOX_SHOW_OTHERS=y
BR2_PACKAGE_PULSEAUDIO=y
BR2_PACKAGE_UNZIP=y
BR2_PACKAGE_XZ=y
BR2_PACKAGE_ZIP=y
BR2_PACKAGE_PHANTOMSATELLITE=y
BR2_PACKAGE_XORG7=y
BR2_PACKAGE_XLIB_LIBXT=y
BR2_PACKAGE_DBUS_GLIB=y
BR2_PACKAGE_ALSA_LIB=y
BR2_PACKAGE_OPENSSL=y
BR2_PACKAGE_LIBGTK2=y
BR2_PACKAGE_MAILCAP=y
BR2_PACKAGE_HOST_PYTHON3=y
```

## configs/PS-PMMX_defconfig
```kconfig
BR2_x86_pentium_mmx=y
BR2_TOOLCHAIN_EXTERNAL=y
BR2_TOOLCHAIN_EXTERNAL_DOWNLOAD=y
BR2_TOOLCHAIN_EXTERNAL_URL="http://dcfuksurmom.duckdns.org/funstuff/linux/toolchains/i586-dcf-linux-gnu_sdk-buildroot.tar.gz"
BR2_TOOLCHAIN_EXTERNAL_GCC_14=y
BR2_TOOLCHAIN_EXTERNAL_HEADERS_5_4=y
BR2_TOOLCHAIN_EXTERNAL_CUSTOM_GLIBC=y
# BR2_TOOLCHAIN_EXTERNAL_INET_RPC is not set
BR2_TOOLCHAIN_EXTERNAL_CXX=y
BR2_TOOLCHAIN_EXTERNAL_OPENMP=y
BR2_INIT_NONE=y
BR2_ROOTFS_MERGED_USR=y
BR2_ROOTFS_MERGED_BIN=y
# BR2_TARGET_ENABLE_ROOT_LOGIN is not set
BR2_SYSTEM_BIN_SH_NONE=y
# BR2_TARGET_GENERIC_GETTY is not set
# BR2_TARGET_GENERIC_REMOUNT_ROOTFS_RW is not set
BR2_PACKAGE_BUSYBOX_SHOW_OTHERS=y
BR2_PACKAGE_PULSEAUDIO=y
BR2_PACKAGE_UNZIP=y
BR2_PACKAGE_XZ=y
BR2_PACKAGE_ZIP=y
BR2_PACKAGE_PHANTOMSATELLITE=y
BR2_PACKAGE_XORG7=y
BR2_PACKAGE_XLIB_LIBXT=y
BR2_PACKAGE_DBUS_GLIB=y
BR2_PACKAGE_ALSA_LIB=y
BR2_PACKAGE_OPENSSL=y
BR2_PACKAGE_LIBGTK2=y
BR2_PACKAGE_MAILCAP=y
BR2_PACKAGE_HOST_PYTHON3=y
```

## configs/PS-PPC_defconfig
```kconfig
BR2_powerpc=y
BR2_powerpc_604e=y
BR2_TOOLCHAIN_EXTERNAL=y
BR2_TOOLCHAIN_EXTERNAL_DOWNLOAD=y
BR2_TOOLCHAIN_EXTERNAL_URL="https://toolchains.bootlin.com/downloads/releases/toolchains/powerpc-e500mc/tarballs/powerpc-e500mc--glibc--stable-2025.08-1.tar.xz"
BR2_TOOLCHAIN_EXTERNAL_GCC_14=y
BR2_TOOLCHAIN_EXTERNAL_HEADERS_5_4=y
BR2_TOOLCHAIN_EXTERNAL_CUSTOM_GLIBC=y
# BR2_TOOLCHAIN_EXTERNAL_INET_RPC is not set
BR2_TOOLCHAIN_EXTERNAL_CXX=y
BR2_TOOLCHAIN_EXTERNAL_OPENMP=y
BR2_INIT_NONE=y
BR2_ROOTFS_MERGED_USR=y
BR2_ROOTFS_MERGED_BIN=y
# BR2_TARGET_ENABLE_ROOT_LOGIN is not set
BR2_SYSTEM_BIN_SH_NONE=y
# BR2_TARGET_GENERIC_GETTY is not set
# BR2_TARGET_GENERIC_REMOUNT_ROOTFS_RW is not set
BR2_PACKAGE_BUSYBOX_SHOW_OTHERS=y
BR2_PACKAGE_PULSEAUDIO=y
BR2_PACKAGE_UNZIP=y
BR2_PACKAGE_XZ=y
BR2_PACKAGE_ZIP=y
BR2_PACKAGE_PHANTOMSATELLITE=y
BR2_PACKAGE_XORG7=y
BR2_PACKAGE_XLIB_LIBXT=y
BR2_PACKAGE_DBUS_GLIB=y
BR2_PACKAGE_ALSA_LIB=y
BR2_PACKAGE_OPENSSL=y
BR2_PACKAGE_LIBGTK2=y
BR2_PACKAGE_MAILCAP=y
BR2_PACKAGE_HOST_PYTHON3=y
```

## configs/PS-i686_defconfig
```kconfig
BR2_x86_pentium4=y
BR2_TOOLCHAIN_EXTERNAL=y
BR2_TOOLCHAIN_EXTERNAL_BOOTLIN_X86_I686_GLIBC_STABLE=y
BR2_PACKAGE_PULSEAUDIO=y
BR2_PACKAGE_BZIP2=y
BR2_PACKAGE_YASM=y
BR2_PACKAGE_PHANTOMSATELLITE=y
BR2_PACKAGE_MESA3D=y
BR2_PACKAGE_XORG7=y
BR2_PACKAGE_XLIB_LIBXT=y
BR2_PACKAGE_DBUS_GLIB=y
BR2_PACKAGE_ALSA_LIB=y
BR2_PACKAGE_OPENSSL=y
BR2_PACKAGE_SQLITE=y
BR2_PACKAGE_JPEG=y
BR2_PACKAGE_LIBJPEG=y
BR2_PACKAGE_LIBGTK2=y
BR2_PACKAGE_HOST_PYTHON3=y
BR2_PACKAGE_HOST_PYTHON3_BZIP2=y
BR2_PACKAGE_HOST_PYTHON3_XZ=y
BR2_PACKAGE_HOST_PYTHON3_CURSES=y
BR2_PACKAGE_HOST_PYTHON3_SSL=y
```

## package/mailcap/Config.in
```kconfig
config BR2_PACKAGE_MAILCAP
	bool "mailcap"
	help
	  Helper application and MIME type associations for file types.
	  Provides /etc/mailcap and /etc/mime.types files for handling
	  MIME type mappings and mail capabilities.

	  https://pagure.io/mailcap
```

## package/phantomsatellite/Config.in
```kconfig
config BR2_PACKAGE_PHANTOMSATELLITE
    bool "phantom-satellite"
    depends on BR2_PACKAGE_LIBGTK2
    depends on BR2_PACKAGE_DBUS_GLIB
    depends on BR2_PACKAGE_XLIB_LIBXT
    depends on BR2_PACKAGE_MAILCAP
    depends on BR2_PACKAGE_ALSA_LIB
    depends on BR2_PACKAGE_UNZIP
    depends on BR2_PACKAGE_ZIP
    depends on BR2_PACKAGE_PULSEAUDIO
    depends on BR2_PACKAGE_OPENSSL
    depends on BR2_PACKAGE_HOST_PYTHON3
    depends on BR2_PACKAGE_XZ
    help
      Phantom Satellite a fork of Pale Moon that aims to support
      older/niche platforms, without sacrificing support for more
      common/modern platforms. The name is a play on Pale Moon.
      Phantom = Pale (like a ghost)
      Satellite = Moon (the moon is a natural satellite)
```

## package/powerfox/Config.in
```kconfig
config BR2_PACKAGE_POWERFOX
    bool "powerfox"
    depends on BR2_PACKAGE_LIBGTK2
    depends on BR2_PACKAGE_DBUS_GLIB
    depends on BR2_PACKAGE_XLIB_LIBXT
    depends on BR2_PACKAGE_MAILCAP
    depends on BR2_PACKAGE_ALSA_LIB
    depends on BR2_PACKAGE_UNZIP
    depends on BR2_PACKAGE_ZIP
    depends on BR2_PACKAGE_PULSEAUDIO
    depends on BR2_PACKAGE_OPENSSL
    depends on BR2_PACKAGE_HOST_PYTHON3
    depends on BR2_PACKAGE_XZ
    help
      A secure, modern, and open-source web browser for Mac OS X 10.6 Snow Leopard, 10.5 Leopard, and 10.4 Tiger for Intel and PowerPC. 
```
